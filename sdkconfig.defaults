## sdkconfig.defaults
```kconfig
# Override some defaults so BT stack is enabled and
# Classic BT is enabled
#CONFIG_BT_ENABLED=y
#CONFIG_BTDM_CTRL_MODE_BLE_ONLY=n
#CONFIG_BTDM_CTRL_MODE_BR_EDR_ONLY=y
#CONFIG_BTDM_CTRL_MODE_BTDM=n
#CONFIG_BT_BLUEDROID_ENABLED=y
#CONFIG_BT_CLASSIC_ENABLED=y
#CONFIG_BT_A2DP_ENABLE=y
#CONFIG_BT_BTC_TASK_PINNED_TO_CORE_1=y
CONFIG_ESPTOOLPY_FLASHSIZE_4MB=y
CONFIG_ESPTOOLPY_FLASHMODE_QIO=y
CONFIG_FREERTOS_ENABLE_BACKWARD_COMPATIBILITY=y
CONFIG_PARTITION_TABLE_CUSTOM=y
CONFIG_PARTITION_TABLE_CUSTOM_FILENAME="partitions_custom.csv"
```
